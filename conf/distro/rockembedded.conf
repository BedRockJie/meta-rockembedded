## conf/distro/rockembedded.conf
```bitbake
require conf/distro/poky.conf

DISTRO = "rockembedded"
DISTRO_NAME = "rockembedded (Bedrock Build Linux by Yocto)"
#DISTRO_VERSION = "3.4+snapshot-${METADATA_REVISION}"
DISTRO_VERSION = "4.0.13"
DISTRO_CODENAME = "kirkstone"
SDK_VENDOR = "-rockembeddedsdk"
SDK_VERSION = "${@d.getVar('DISTRO_VERSION').replace('snapshot-${METADATA_REVISION}', 'snapshot')}"
SDK_VERSION[vardepvalue] = "${SDK_VERSION}"

MAINTAINER = "rockembedded <bedrock_jie@foxmail.com>"

TARGET_VENDOR = "-rockembedded"
```

## conf/layer.conf
```bitbake
# We have a conf and classes directory, add to BBPATH
BBPATH .= ":${LAYERDIR}"

# We have recipes-* directories, add to BBFILES
BBFILES += "${LAYERDIR}/recipes-*/*/*.bb \
            ${LAYERDIR}/recipes-*/*/*.bbappend"

BBFILE_COLLECTIONS += "meta-rockembedded"
BBFILE_PATTERN_meta-rockembedded = "^${LAYERDIR}/"
BBFILE_PRIORITY_meta-rockembedded = "6"

LAYERDEPENDS_meta-rockembedded = "core"
LAYERSERIES_COMPAT_meta-rockembedded = "kirkstone"
```
